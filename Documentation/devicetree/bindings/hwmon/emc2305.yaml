## Documentation/devicetree/bindings/hwmon/emc2305.yaml
```yaml
# SPDX-License-Identifier: (GPL-2.0 OR BSD-2-Clause)
%YAML 1.2
---

$id: http://devicetree.org/schemas/hwmon/emc2305.yaml#
$schema: http://devicetree.org/meta-schemas/core.yaml#

title: RPM-based PWM Fan Speed Controller EMC2305

maintainers:
  - Claud Chang<claud.chang@deltaww.com>

properties:
  compatible:
    enum:
      - emc2305

  emc2305,min-pwm:
    description:
      Min pwm of emc2305
    maxItems: 1
  emc2305,max-pwm:
    description:
      Max pwm of emc2305
    maxItems: 1
  emc2305,cooling-levels:
    description:
      Quantity of cooling level state.
    maxItems: 1

required:
  - compatible
  - emc2305,min-pwm
  - emc2305,max-pwm
  - emc2305,cooling-levels

additionalProperties: false

examples:
  - |
    fan@1 {
        compatible = "smsc,emc2305";
        emc2305,min-pwm = <0>;
        emc2305,max-pwm = <255>;
        emc2305,cooling-levels = <10>;
    }
```
